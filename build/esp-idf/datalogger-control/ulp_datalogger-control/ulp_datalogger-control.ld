
/* ULP variable definitions for the linker.
 * This file is generated automatically by esp32ulp_mapgen.py utility.
 */
PROVIDE ( ulp_changed = 0x50000164 );
PROVIDE ( ulp_debounce_counter = 0x50000270 );
PROVIDE ( ulp_debounce_max_count = 0x50000274 );
PROVIDE ( ulp_edge_count = 0x50000278 );
PROVIDE ( ulp_edge_count_to_wake_up = 0x5000027c );
PROVIDE ( ulp_edge_detected = 0x50000180 );
PROVIDE ( ulp_entrance = 0x50000010 );
PROVIDE ( ulp_entry = 0x500000ac );
PROVIDE ( ulp_err_halt = 0x5000000c );
PROVIDE ( ulp_exit = 0x5000007c );
PROVIDE ( ulp_ext_sensor_activated = 0x5000025c );
PROVIDE ( ulp_ext_sensor_status = 0x50000258 );
PROVIDE ( ulp_ext_sensor_status_next = 0x50000284 );
PROVIDE ( ulp_gpio_extern_sensor = 0x50000078 );
PROVIDE ( ulp_inactivity = 0x50000268 );
PROVIDE ( ulp_io_ext_sensor = 0x50000288 );
PROVIDE ( ulp_io_number = 0x50000280 );
PROVIDE ( ulp_io26_debounce_counter = 0x50000250 );
PROVIDE ( ulp_io26_debounce_max_count = 0x50000254 );
PROVIDE ( ulp_next_edge = 0x5000026c );
PROVIDE ( ulp_pulse_status = 0x50000000 );
PROVIDE ( ulp_pulse_status_next = 0x50000004 );
PROVIDE ( ulp_pulsed = 0x50000008 );
PROVIDE ( ulp_sleep_transition_counter = 0x50000264 );
PROVIDE ( ulp_system_stable = 0x50000260 );
PROVIDE ( ulp_wake_up = 0x50000090 );
